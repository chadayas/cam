## main/Kconfig.projbuild
```kconfig
menu "Wifi Credentials"
config WIFI_NAME
	string "wifi_name"
	default "myssid"
config WIFI_PW
	string "wifi_password"
	default "mypass"
endmenu

menu "Camera Auth"
config CAM_USERNAME
	string "cam_username"
	default "admin"
config CAM_PASSWORD
	string "cam_password"
	default "password"
endmenu
```
